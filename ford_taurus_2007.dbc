VERSION ""

NS_ :

BS_:

BU_: XXX

BO_ 513 dash_controls: 8 XXX
 SG_ DASH_RPM : 7|16@0+ (1,0) [0|65535] "" XXX
 SG_ DASH_SPEED : 39|16@0+ (1,0) [0|65535] "" XXX
